#include <SoftwareSerial.h>

SoftwareSerial BTSerial(11, 10); //RX|TX
SoftwareSerial JoeySerial(13,12);

//int testData[255] = {
//  46,80,76,59,42,27,-2,-35,-16,34,7,-44,32,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3,
//  65,111,20,-106,-120,-51,-3,11,0,-41,-60,-11,22,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-54,
//  -27,14,1,-18,9,9,-48,-35,73,113,40,13,77,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35,
//  6,16,47,74,59,1,-34,-16,0,-6,-1,4,-5,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79,
////  56,40,-9,21,188,280,144,-36,-62,-13,-3,-3,17,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7,
////  -4,10,22,12,0,16,46,49,16,-11,6,44,52,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27
////  ,12,-15,-3,37,45,18,0,4,23,49,48,5,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14,
////  29,28,4,0,34,48,15,-11,-24,-56,-31,111,204,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61,
////  80,6,-47,-21,-16,-26,72,199,157,-3,-80,-70,-79,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144
//  };

int testData[255] =
{
69,27,138,43,149,36,165,32,84,63,106,61,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13

};

short heartTestData[255] =
{
0,1,2,3,4,5,6,7,8,9,10,11,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154
};

byte mHasArrhythmia=0x00;
byte mAmplitude[2];
byte mHeartRate=0x00;

byte output[4];

uint16_t i=0;

void setup(){
  Serial.begin(9600);
  Serial2.begin(9600); // default baud rate
  JoeySerial.begin(9600);
  while(!Serial); //if it is an Arduino Micro
  Serial.println("Karson's output: ");
}

void loop(){
  //read from the HM-10 and print in the Serial
  if(i==255)
  {
    i=0;
  }
  if(JoeySerial.available())
  {
    Serial.write(JoeySerial.read());
  }
//  if(BTSerial.available())
//    Serial.write(BTSerial.read());
//    
//  //read from the Serial and print to the HM-10
//  if(Serial.available())
//  {
//    BTSerial.write(Serial.read());
//  }
  Serial.println(testData[i]);
  int temp = testData[i];
  temp &= 0xFF;
  mAmplitude[0] = testData[i]>>8 & 0xFF;
  mAmplitude[1] = temp;

 int heartrate = heartTestData[i]; //random(255);
 int arryth = 1;
  output[3] = (byte)heartrate; //heart rate
  output[1] = mAmplitude[0];
  output[2] = mAmplitude[1];
  output[0] = (byte)arryth;  //arryhthmia
  //Serial.write(output, 5);
  Serial2.write(output,4);
}
